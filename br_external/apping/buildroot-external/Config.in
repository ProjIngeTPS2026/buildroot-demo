## br_external/apping/buildroot-external/Config.in
```kconfig
menu "Apping"

source "$BR2_EXTERNAL_APPING_PATH/package/apping-roc-toolkit-opus/Config.in"
source "$BR2_EXTERNAL_APPING_PATH/package/apping-fixed-base/Config.in"
source "$BR2_EXTERNAL_APPING_PATH/package/apping-portable-ui/Config.in"

config BR2_PACKAGE_APPING_ROC_MULTICAST_IFACE
	string "Roc multicast interface"
	depends on BR2_PACKAGE_APPING_FIXED_BASE || BR2_PACKAGE_APPING_PORTABLE_UI
	help
	  Optional interface passed through APPING_ROC_MULTICAST_IFACE.
	  It may be an IPv4 address, or an interface name resolved by Apping
	  before calling Roc.
	  Leave empty for normal target routing. Set it to the batman-adv mesh
	  interface only if Roc needs an explicit multicast interface.

endmenu
```

## br_external/apping/buildroot-external/package/apping-fixed-base/Config.in
```kconfig
config BR2_PACKAGE_APPING_FIXED_BASE
	bool "apping-fixed-base"
	depends on BR2_INSTALL_LIBSTDCPP
	depends on BR2_TOOLCHAIN_GCC_AT_LEAST_10
	depends on BR2_TOOLCHAIN_HAS_THREADS_NPTL
	depends on BR2_USE_WCHAR
	depends on !BR2_STATIC_LIBS
	select BR2_PACKAGE_APPING_ROC_TOOLKIT_OPUS
	select BR2_PACKAGE_QT5BASE
	select BR2_PACKAGE_QT5MULTIMEDIA
	select BR2_PACKAGE_GST1_PLUGINS_BASE
	select BR2_PACKAGE_GST1_PLUGINS_BASE_PLUGIN_ALSA
	select BR2_PACKAGE_GST1_PLUGINS_BASE_PLUGIN_AUDIOCONVERT
	select BR2_PACKAGE_GST1_PLUGINS_BASE_PLUGIN_AUDIORESAMPLE
	select BR2_PACKAGE_GST1_PLUGINS_BASE_PLUGIN_PLAYBACK
	select BR2_PACKAGE_GST1_PLUGINS_BASE_PLUGIN_TYPEFIND
	select BR2_PACKAGE_GST1_PLUGINS_BASE_PLUGIN_VOLUME
	select BR2_PACKAGE_GST1_PLUGINS_GOOD
	select BR2_PACKAGE_GST1_PLUGINS_GOOD_PLUGIN_AUTODETECT
	select BR2_PACKAGE_GST1_PLUGINS_GOOD_PLUGIN_WAVPARSE
	help
	  Fixed base service for Apping speaker poles.

comment "apping-fixed-base needs a C++20 capable toolchain with NPTL, wchar and shared libraries"
	depends on !BR2_INSTALL_LIBSTDCPP || !BR2_TOOLCHAIN_GCC_AT_LEAST_10 || !BR2_TOOLCHAIN_HAS_THREADS_NPTL || !BR2_USE_WCHAR || BR2_STATIC_LIBS
```

## br_external/apping/buildroot-external/package/apping-portable-ui/Config.in
```kconfig
config BR2_PACKAGE_APPING_PORTABLE_UI
	bool "apping-portable-ui"
	depends on BR2_INSTALL_LIBSTDCPP
	depends on BR2_TOOLCHAIN_GCC_AT_LEAST_10
	depends on BR2_TOOLCHAIN_HAS_THREADS_NPTL
	depends on BR2_USE_WCHAR
	depends on !BR2_STATIC_LIBS
	select BR2_PACKAGE_APPING_ROC_TOOLKIT_OPUS
	select BR2_PACKAGE_QT5BASE
	select BR2_PACKAGE_QT5BASE_GUI
	select BR2_PACKAGE_QT5BASE_LINUXFB
	select BR2_PACKAGE_QT5BASE_WIDGETS
	select BR2_PACKAGE_QT5MULTIMEDIA
	select BR2_PACKAGE_GST1_PLUGINS_BASE
	select BR2_PACKAGE_GST1_PLUGINS_BASE_PLUGIN_ALSA
	select BR2_PACKAGE_GST1_PLUGINS_BASE_PLUGIN_AUDIOCONVERT
	select BR2_PACKAGE_GST1_PLUGINS_BASE_PLUGIN_AUDIORESAMPLE
	select BR2_PACKAGE_GST1_PLUGINS_BASE_PLUGIN_PLAYBACK
	select BR2_PACKAGE_GST1_PLUGINS_BASE_PLUGIN_TYPEFIND
	select BR2_PACKAGE_GST1_PLUGINS_BASE_PLUGIN_VOLUME
	select BR2_PACKAGE_GST1_PLUGINS_GOOD
	select BR2_PACKAGE_GST1_PLUGINS_GOOD_PLUGIN_AUTODETECT
	select BR2_PACKAGE_GST1_PLUGINS_GOOD_PLUGIN_WAVPARSE
	help
	  Qt5 Widgets portable control UI for Apping.

comment "apping-portable-ui needs a C++20 capable toolchain with NPTL, wchar and shared libraries"
	depends on !BR2_INSTALL_LIBSTDCPP || !BR2_TOOLCHAIN_GCC_AT_LEAST_10 || !BR2_TOOLCHAIN_HAS_THREADS_NPTL || !BR2_USE_WCHAR || BR2_STATIC_LIBS
```

## br_external/apping/buildroot-external/package/apping-roc-toolkit-opus/Config.in
```kconfig
config BR2_PACKAGE_APPING_ROC_TOOLKIT_OPUS
	bool "apping-roc-toolkit-opus"
	depends on BR2_INSTALL_LIBSTDCPP
	depends on BR2_TOOLCHAIN_HAS_THREADS_NPTL
	depends on BR2_USE_WCHAR
	depends on !BR2_STATIC_LIBS
	select BR2_PACKAGE_ALSA_LIB
	select BR2_PACKAGE_LIBSNDFILE
	select BR2_PACKAGE_LIBUV
	select BR2_PACKAGE_OPUS
	select BR2_PACKAGE_PULSEAUDIO
	select BR2_PACKAGE_SPEEXDSP
	help
	  Local Roc Toolkit build modified for Apping live audio.
	  Installs roc-send and roc-recv with Opus support.

comment "apping-roc-toolkit-opus needs a C++ toolchain with NPTL, wchar and shared libraries"
	depends on !BR2_INSTALL_LIBSTDCPP || !BR2_TOOLCHAIN_HAS_THREADS_NPTL || !BR2_USE_WCHAR || BR2_STATIC_LIBS
```

## br_external/morse_micro/Config.in
```kconfig
menu "Morse External Packages"
    source "$BR2_EXTERNAL_MORSE_EXTERNAL_PATH/package/morse/Config.in"
    source "$BR2_EXTERNAL_MORSE_EXTERNAL_PATH/package/morse-tools/Config.in"
    source "$BR2_EXTERNAL_MORSE_EXTERNAL_PATH/package/morse-cli/Config.in"
endmenu
```

## br_external/morse_micro/package/morse-cli/Config.in
```kconfig
config BR2_PACKAGE_MORSE_CLI
	bool "Morse Micro CLI tools"
	depends on BR2_TOOLCHAIN_HAS_THREADS # libnl
	depends on BR2_TOOLCHAIN_GCC_AT_LEAST_4_9 # libusb
	select BR2_PACKAGE_LIBNL
	select BR2_PACKAGE_LIBUSB
	help
	  Morse Micro user-space control utility.

comment "Morse Micro CLI tools need a toolchain w/ threads"
	depends on !BR2_TOOLCHAIN_HAS_THREADS

comment "Morse Micro CLI tools need a toolchain w/ gcc >= 4.9"
	depends on BR2_TOOLCHAIN_HAS_THREADS
	depends on !BR2_TOOLCHAIN_GCC_AT_LEAST_4_9
```

## br_external/morse_micro/package/morse-tools/Config.in
```kconfig
config BR2_PACKAGE_MORSE_TOOLS
	bool "Morse Micro S1G hostap/wpa_supplicant"
	depends on BR2_USE_MMU # fork()
	depends on BR2_TOOLCHAIN_HAS_THREADS # libnl
	depends on BR2_TOOLCHAIN_GCC_AT_LEAST_4_9 # morse-cli -> libusb
	select BR2_PACKAGE_LIBNL
	select BR2_PACKAGE_OPENSSL
	select BR2_PACKAGE_OPENSSL_FORCE_LIBOPENSSL
	select BR2_PACKAGE_LIBOPENSSL_ENABLE_DES
	select BR2_PACKAGE_LIBOPENSSL_ENABLE_MD4
	select BR2_PACKAGE_MORSE_CLI
	help
	  Morse Micro's 802.11ah/S1G hostap tree.

	  This package installs S1G-specific binaries with separate names:
	  wpa_supplicant_s1g, wpa_cli_s1g, wpa_passphrase_s1g,
	  hostapd_s1g and hostapd_cli_s1g.

	  It does not replace Buildroot's standard wpa_supplicant or
	  hostapd packages.

comment "Morse Micro S1G hostap/wpa_supplicant needs a toolchain w/ threads"
	depends on BR2_USE_MMU
	depends on !BR2_TOOLCHAIN_HAS_THREADS

comment "Morse Micro S1G hostap/wpa_supplicant needs a toolchain w/ gcc >= 4.9"
	depends on BR2_USE_MMU
	depends on BR2_TOOLCHAIN_HAS_THREADS
	depends on !BR2_TOOLCHAIN_GCC_AT_LEAST_4_9

comment "Morse Micro S1G hostap/wpa_supplicant needs MMU"
	depends on !BR2_USE_MMU
```

## br_external/morse_micro/package/morse/Config.in
```kconfig
config BR2_PACKAGE_MORSE
    bool "Morse Micro WiFi HaLow driver"
    depends on BR2_LINUX_KERNEL
    help
      Kernel module for Morse Micro WiFi HaLow chips (802.11ah)
```
